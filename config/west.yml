## config/west.yml
```yaml
manifest:
  remotes:
    - name: zmkfirmware
      url-base: https://github.com/zmkfirmware
    - name: 280Zo
      url-base: https://github.com/280Zo
    - name: alanjose10
      url-base: https://github.com/alanjose10

  projects:
    - name: zmk
      remote: zmkfirmware
      revision: main
      import: app/west.yml
    - name: zmk-pmw3610-driver
      remote: 280Zo
      revision: main
    - name: prospector-zmk-module
      remote: 280Zo
      revision: main
    # Shared with the hillside46 config (zmk-config). Bump the tag in both configs together.
    - name: zmk-caffeine
      remote: alanjose10
      revision: v0.1.0

  self:
    path: config
```

## zmk-caffeine/dts/bindings/behaviors/zmk,behavior-caffeine.yaml
```yaml
description: |
  Caffeine behavior. Press to toggle. While on, taps the listed bindings on a
  timer to keep the host awake.

compatible: "zmk,behavior-caffeine"

include: zero_param.yaml

properties:
  bindings:
    type: phandle-array
    required: true
    description: Behaviors to tap.
  interval-ms:
    type: int
    default: 30000
    description: Time between ticks in milliseconds.
  tap-ms:
    type: int
    default: 30
    description: Time between press and release of each tap in milliseconds.
  wait-ms:
    type: int
    default: 0
    description: Pause between taps inside one tick in sequence mode, in milliseconds.
  mode:
    type: string
    default: "rotate"
    enum:
      - "rotate"
      - "sequence"
    description: |
      rotate: tap one binding per tick, in turn.
      sequence: tap every binding per tick, back to back, so a closed shape
      such as up/left/down/right returns the pointer to where it started.
  cancel-on-keypress:
    type: boolean
    description: Turn caffeine off when any keycode is pressed.
```

## zmk-dongle-reset/Kconfig
```kconfig
config ZMK_BEHAVIOR_DONGLE_RESET
    bool "Dongle reset behavior"
    default y
    depends on DT_HAS_ZMK_BEHAVIOR_DONGLE_RESET_ENABLED
    # Runs on the central only; ZMK compiles behaviors there.
    depends on !ZMK_SPLIT || ZMK_SPLIT_ROLE_CENTRAL
    help
      Reset or bootloader behavior that always acts on the central (dongle),
      no matter which half the key was pressed on.
```

## zmk-dongle-reset/dts/bindings/behaviors/zmk,behavior-dongle-reset.yaml
```yaml
description: |
  Reset behavior that acts on the central (dongle) regardless of which
  half the key was pressed on.

compatible: "zmk,behavior-dongle-reset"

include: zero_param.yaml

properties:
  type:
    type: int
    default: 0
    description: sys_reboot type. RST_WARM for a normal reset, RST_UF2 for the UF2 bootloader.
  bootloader:
    type: boolean
    description: Enter the bootloader when retention boot mode is enabled.
```
